
            /* generated memory regions file - do not edit */
                define symbol RAM_START = 0x20000000;
                define symbol RAM_LENGTH   = 0x40000;
                define symbol FLASH_START = 0x00000000;
                define symbol FLASH_LENGTH   = 0x002000;                /*Aclara modified: limit size to 8K start-up program memory (block0) */
                define symbol DATA_FLASH_START = 0x08000000;
                define symbol DATA_FLASH_LENGTH   = 0x2000;
                define symbol OPTION_SETTING_START = 0x0100A100;
                define symbol OPTION_SETTING_LENGTH   = 0x100;
                define symbol OPTION_SETTING_S_START = 0x0100A200;
                define symbol OPTION_SETTING_S_LENGTH   = 0x100;
                define symbol ID_CODE_START = 0x00000000;
                define symbol ID_CODE_LENGTH   = 0x0;
                define symbol SDRAM_START = 0x90000000;
                define symbol SDRAM_LENGTH   = 0x0;
                define symbol QSPI_FLASH_START = 0x60000000;
                define symbol QSPI_FLASH_LENGTH   = 0x4000000;
                define symbol OSPI_DEVICE_0_START = 0x68000000;
                define symbol OSPI_DEVICE_0_LENGTH   = 0x0;
                define symbol OSPI_DEVICE_1_START = 0x70000000;
                define symbol OSPI_DEVICE_1_LENGTH   = 0x0;

                define symbol OPTION_SETTINGS_EXCLUDE = 1;				/*Aclara modified: exclude option settings in .bin */
                define symbol LNKR_BL_FW_VER_ADDR = 0x00000040;         /*Aclara added: location of BL version */
                define symbol VERSION_SIZE = 0x20;                      /*Aclara added: 4B Version, 12B Date, 9B Time, 7B RSVD */
