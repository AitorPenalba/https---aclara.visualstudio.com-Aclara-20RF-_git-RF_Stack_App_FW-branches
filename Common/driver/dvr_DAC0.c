/******************************************************************************
 *
 * Filename: dvr_DAC0.c
 *
 * Global Designator: DVR_DAC0_
 *
 * Contents: Contains the driver for DAC0 module
 *
 ******************************************************************************
 * A product of
 * Aclara Technologies LLC
 * Confidential and Proprietary
 * Copyright 2020-2022 Aclara.  All Rights Reserved.
 *
 * PROPRIETARY NOTICE
 * The information contained in this document is private to Aclara Technologies LLC an Ohio limited liability company
 * (Aclara).  This information may not be published, reproduced, or otherwise disseminated without the express written
 * authorization of Aclara.  Any software or firmware described in this document is furnished under a license and may
 * be used or copied only in accordance with the terms of such license.
 *****************************************************************************/

/* ****************************************************************************************************************** */
/* INCLUDE FILES */
#include "project.h"
#if ( MCU_SELECTED == RA6E1 )
#include "hal_data.h"
#endif

#if ( MCU_SELECTED == NXP_K24 )
#if ( DAC_CODE_CONFIG == 1 )
#include "dvr_DAC0.h"
#include "PHY.h"
#include "DBG_SerialDebug.h"
#include "math.h"
#include "UplinkPower_Control.h"
#include "radio.h"
#include "radio_hal.h"

/* ****************************************************************************************************************** */
/* #DEFINE DEFINITIONS */

PACK_BEGIN
typedef struct
{
   uint16_t   frequencyMHz;
   int8_t     dBM;
   uint16_t   dacStep;
   int8_t     temperature;
} struct_DAC_Lookup;
PACK_END

/* CONSTANTS */
static const struct_DAC_Lookup struct_dacSoteps[1188] =
{
{ 452,-20,1486,-40    },
{ 452,-15,1770,-40    },
{ 452,-10,2081,-40    },
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{ 462,30,4091,60      }

};

/* ****************************************************************************************************************** */
/* MACRO DEFINITIONS */

/* ****************************************************************************************************************** */
/* TYPE DEFINITIONS */

/* ****************************************************************************************************************** */
/* CONSTANTS */

/* ****************************************************************************************************************** */
/* FILE VARIABLE DEFINITIONS */

/* ****************************************************************************************************************** */
/* FUNCTION DEFINITIONS */
#endif
#endif //if 0
/*******************************************************************************

  Function name: DVR_DAC0_init

  Purpose: Initialize the DAC0 module

  Arguments: None

  Returns: InitSuccessful - true if everything was successful, false if something failed

  Notes: This opens the DAC module

*******************************************************************************/
returnStatus_t DVR_DAC0_init ( void )
{
   returnStatus_t retVal = eSUCCESS;
#if ( MCU_SELECTED == NXP_K24 )
   /* Enable the clock gate to the DAC0 module */
   SIM_SCGC2 |= SIM_SCGC2_DAC0_MASK;

   DAC0_C0 = DAC_C0_DACEN_MASK | DAC_C0_DACRFS_MASK;    /* Enable DAC0 and select DACREF_2 as the reference voltage */
   DAC0_C1 = 0;
   DAC0_C2 = 0;
#elif ( MCU_SELECTED == RA6E1 )
   (void)R_DAC_Open(&g_dac0_ULPC_ctrl, &g_dac0_ULPC_cfg);
   //Enable access to the PFS registers
   R_BSP_PinAccessEnable();
   // 3V6LDO_EN
   R_BSP_PinWrite(BSP_IO_PORT_04_PIN_04, BSP_IO_LEVEL_HIGH);
   //RX0TX1
   R_BSP_PinWrite(BSP_IO_PORT_03_PIN_07, BSP_IO_LEVEL_HIGH);
   //SKY_EN
   R_BSP_PinWrite(BSP_IO_PORT_03_PIN_06, BSP_IO_LEVEL_HIGH);
   // ON DELAY
   R_BSP_SoftwareDelay(1, BSP_DELAY_UNITS_SECONDS);
   //Disable access to the PFS registers
   R_BSP_PinAccessDisable();
#endif


   return ( retVal );
}

/*******************************************************************************

  Function name: DVR_DAC0_setVoltageStep

  Purpose: This function is used to set the DAC voltage

  Arguments: step value to control the output voltage of the DAC0

  Returns: Always success

  Notes:

*******************************************************************************/
void DVR_DAC0_setVoltageStep ( uint16_t stepValue )
{
#if ( MCU_SELECTED == NXP_K24 )
    /* DATA[11:0] controls the output voltage based on the following
      formula: V out = V in * (1 + DACDAT0[11:0])/4096. Buffer mode
      is disabled. */
   DAC0_DAT0L = 0xFF & stepValue;           /* DAC0 DATA0 Low Register (8-Bits LSB) */
   DAC0_DAT0H = 0x0F & ( stepValue >> 8 );  /* DAC0 DATA1 High Register (4-Bits MSB) */
#elif ( MCU_SELECTED == RA6E1 )
      (void)R_DAC_Write(&g_dac0_ULPC_ctrl, stepValue );
      /* Start DAC conversion */
      (void)R_DAC_Start (&g_dac0_ULPC_ctrl);
#endif
}
#if ( MCU_SELECTED == NXP_K24 )
#if ( DAC_CODE_CONFIG == 1 )
/*******************************************************************************

  Function name: DVR_DAC0_setDacCode

  Purpose:

  Arguments:

  Returns: Always success

  Notes:

*******************************************************************************/
returnStatus_t DVR_DAC0_setDacCode ( uint16_t channelNumber, float32_t dBM )
{
   returnStatus_t retVal = eSUCCESS;
   int            i;
   uint16_t       channelRange = 457; /* Assigning 457 as the default value if the channel range doesn't match */
   bool           lookUpSearchSuccessful = false;
   int8_t         powerVal;
   int16_t        radioTemperature;
   int16_t        temperatureCeilingVal;

   /* dBM ceiling table
    ___________________________________
   |   dBm Rrange    |Ceiled dBm Value |
   |-----------------|-----------------|
   | -20 and Above   |   -20           |
   | -19 to -15      |   -15           |
   | -14 to -10      |   -10           |
   | -9 to -5        |   -5            |
   | -4 to -1        |    0            |
   | 0 to 4          |    5            |
   | 5 to 9          |    10           |
   | 10 to 14        |    15           |
   | 15 to 19        |    20           |
   | 20 to 24        |    25           |
   | 25 to 29        |    30           |
   | above 30        |    30           |
   -------------------------------------
   dBM ceiling as per the above table */

   if ( dBM < 0)
   {
      if ( dBM < -20 )
      {
         powerVal = -20;
      }
      else
      {
         powerVal = (  (int8_t)roundf(dBM) - ( (int8_t)roundf(dBM) % 5 ) );
      }
   }
   else
   {
      if ( dBM > 24 )
      {
         powerVal = 30;
      }
      else
      {
         powerVal = (  (int8_t)roundf(dBM) + ( 5 - ( (int8_t)roundf(dBM) % 5 ) ) ) ;
      }
   }

   DBG_logPrintf( 'R', "The ceiled dBM value: %d\n",  powerVal );

/*  ____________________________________________
   |  Channel Rrange | Frequency sub-band (MHz) |
   |-----------------|-----------------         |
   | 190 to 478      |      452                 |
   | 990 to 1079     |      456                 |
   | 1080 to 1168    |      457                 |
   | 1169 to 1258    |      458                 |
   | 1950 to 1990    |      462                 |
   ---------------------------------------------
   Assigning the channel range for the passed channel number as per the above table */
   if ( ( channelNumber >= 190 ) && ( channelNumber <= 478 ) )
   {
      channelRange = 452;
   }
   else if ( ( channelNumber >= 990 ) && ( channelNumber <= 1079 ) )
   {
      channelRange = 456;
   }
   else if ( ( channelNumber >= 1080 ) && ( channelNumber <= 1168 ) )
   {
      channelRange = 457;
   }
   else if ( ( channelNumber >= 1169 ) && ( channelNumber <= 1258 ) )
   {
      channelRange = 458;
   }
   else if ( ( channelNumber >= 1950 ) && ( channelNumber <= 1990 ) )
   {
      channelRange = 462;
   }

   /* WARNING: RADIO_Temperature_Get() should not be called directly by any other task other than PHY_TSK, use PHY_GetRequest instead.
                Using PHY_GetRequest() in PHY_TSK will result in failure as it waits in it's own queue causing a lock-up condition
      NOTE: RADIO_Temperature_Get() will take 1msec delay to acquire the temperature */
#if ( MCU_SELECTED == NXP_K24 )
   if ( RADIO_Temperature_Get( (uint8_t)RADIO_0, &radioTemperature ) )
   {
#elif ( MCU_SELECTED == RA6E1 )
   if ( RADIO_Get_Chip_Temperature( (uint8_t)RADIO_0, &radioTemperature ) )
   {
#endif
      INFO_printf( "RF Algorithm: Radio(phy) Temperature %d\n",  radioTemperature );
   }
   else
   {
      /* If the RADIO_Temperature_Get() API fails, assign the max temperature of 60 degree celcius */
      radioTemperature = 60;
      ERR_printf("Temperature acquistion failed and default value of 60 degree celcius is assigned");
   }

   /*_________________________________________
     | Radio Temperature| Ceiled Temperature |
     |------------------|--------------------|
     | -36 to -40       |      -40           |
     | -35 to -25       |      -30           |
     | -24 to -15       |      -20           |
     | -14 to -5        |      -10           |
     | -4 to 5	        |      0             |
     | 6 to 15	        |      10            |
     | 16 to 20         |      20            |
     | 21 to 25         |      25            |
     | 25 to 35         |      30            |
     | 36 to 45         |      40            |
     | 46 to 55         |      50            |
     | 56 to 70         |      60            |
     -----------------------------------------
   temperature ceiling as per the above table */

   if ( radioTemperature <= -36 )
   {
      temperatureCeilingVal = -40;
   }
   else if ( ( radioTemperature >= -35 ) && ( radioTemperature <= -25 ) )
   {
      temperatureCeilingVal = -30;
   }
   else if ( ( radioTemperature >= -24 ) && ( radioTemperature <= -15 )  )
   {
      temperatureCeilingVal = -20;
   }
   else if ( ( radioTemperature >= -14 ) && ( radioTemperature <= -5 ) )
   {
      temperatureCeilingVal = -10;
   }
   else if ( ( radioTemperature <= 5 ) && ( radioTemperature >= -4 ) )
   {
      temperatureCeilingVal = 0;
   }
   else if ( ( radioTemperature <= 15 ) && ( radioTemperature >= 6 ) )
   {
      temperatureCeilingVal = 10;
   }
   else if ( ( radioTemperature <= 20 ) && ( radioTemperature >= 16 ) )
   {
      temperatureCeilingVal = 20;
   }
   else if ( ( radioTemperature <= 25 ) && ( radioTemperature >= 21 ) )
   {
      temperatureCeilingVal = 25;
   }
   else if ( ( radioTemperature <= 35 ) && ( radioTemperature >= 26 ) )
   {
      temperatureCeilingVal = 30;
   }
   else if ( ( radioTemperature <= 45 ) && ( radioTemperature >= 36 ) )
   {
      temperatureCeilingVal = 40;
   }
   else if ( ( radioTemperature <= 55 ) && ( radioTemperature >= 46 ) )
   {
      temperatureCeilingVal = 50;
   }
   else if ( radioTemperature > 55 )
   {
      temperatureCeilingVal = 60;
   }

   DBG_logPrintf( 'R', "RF Algorithm: Ceiled Temperature val: %d\n",  temperatureCeilingVal );

   for (i = 0; i < ARRAY_IDX_CNT(struct_dacSoteps); i++)
   {
      if ( (struct_dacSoteps[i].frequencyMHz == channelRange) && (struct_dacSoteps[i].temperature == temperatureCeilingVal) && (struct_dacSoteps[i].dBM == powerVal) )
      {
         DBG_logPrintf( 'R', "RF Algorithm: the selected entry: %d and dacStep: %d", i, struct_dacSoteps[i].dacStep );
         int dacOffsetVal;
         /* At max power do not add the offset */
         if ( 30 == powerVal )
         {
            dacOffsetVal = struct_dacSoteps[i].dacStep;
            DBG_logPrintf( 'R', "At max power do not add the offset " );
         }
         else
         {
            dacOffsetVal = struct_dacSoteps[i].dacStep + DVR_DAC0_setOffset( channelNumber );
         }

         DVR_DAC0_setVoltageStep( dacOffsetVal );
         DBG_logPrintf( 'R', "RF Algorithm: DAC offsetvalue %d", dacOffsetVal );
         lookUpSearchSuccessful = true;
         break;
      }
   }

   if ( true == lookUpSearchSuccessful )
   {
#if 0 /* use if power level needs to be changed */
      /* Set Power Level */
      if ( struct_dacSoteps[i].dBM < 0 )
      {
         PowerSetting = 6;
      }
      else
      {
         PowerSetting = 10;
      }

      SetConf = PHY_SetRequest( ePhyAttr_PowerSetting, &PowerSetting);
      if (SetConf.eStatus == ePHY_SET_SUCCESS)
      {
         DBG_printf( "RF Algorithm: Power level is set to %u", PowerSetting );
      }
      else
      {
         DBG_printf( "RF Algorithm: Failed to set power" );
         retVal = eFAILURE;
      }
#endif
   }
   else
   {
      /* If no entry in the LUP table is matching then set max value of 4095 to the DAC */
      DVR_DAC0_setVoltageStep( 4095 );
      ERR_printf( "RF Algorithm: No such entry identified in the LUP table and max value of 4095 is set" );
      retVal = eFAILURE;
   }

   return retVal;
}

/*******************************************************************************

  Function name: DVR_DAC0_setOffset

  Purpose: This function is used to set the DAC voltage

  Arguments: step value to control the output voltage of the DAC0

  Returns: Always success

  Notes:

*******************************************************************************/
int16_t DVR_DAC0_setOffset ( int16_t channelNumber )
{
   int dacOffsetVal;

   if ( ( channelNumber >= 190 ) && ( channelNumber <= 344 ) )
   {
      dacOffsetVal = ULPC_getDacOffset( 0 );
   }
   else if ( ( channelNumber >= 335 ) && ( channelNumber <= 478 ) )
   {
      dacOffsetVal = ULPC_getDacOffset( 1 );
   }
   else if ( ( channelNumber >= 990 ) && ( channelNumber <= 1258 ) )
   {
      dacOffsetVal = ULPC_getDacOffset( 2 );
   }
   else if ( ( channelNumber >= 1950 ) && ( channelNumber <= 1990 ) )
   {
      dacOffsetVal = ULPC_getDacOffset( 3 );
   }

   return dacOffsetVal;
}

/*******************************************************************************

  Function name: DVR_DAC0_disable

  Purpose: Disable the DAC0 module

  Arguments: None

  Returns: None

*******************************************************************************/
void DVR_DAC0_disable(void)
{
   DAC0_C0 &= ~(1 << DAC_C0_DACEN_SHIFT);    /* Disable DAC0 module */
   /* Disable the clock gate to the DAC0 module */
   SIM_SCGC2 &= ~(1 << SIM_SCGC2_DAC0_SHIFT);  // Clear bit - 0xEFFF;
}
#endif
#endif